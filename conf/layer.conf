## conf/layer.conf
```bitbake
BBPATH .= ":${LAYERDIR}"

BBFILES += "${LAYERDIR}/recipes-*/*/*.bb \
        ${LAYERDIR}/recipes-*/*/*.bbappend"

BBFILE_COLLECTIONS += "meta-test"
BBFILE_PATTERN_meta-test = "^${LAYERDIR}/recipes-"
BBFILE_PRIORITY_meta-test = "6"

LAYERSERIES_COMPAT_meta-test = "next"

LAYERDIR_meta-test = "${LAYERDIR}"
LAYERDIR_meta-test[vardepvalue] = "meta-test"
```
